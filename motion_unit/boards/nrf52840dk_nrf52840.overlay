/* MPU6050 on I2C0 (DK default pins: SDA = P0.26, SCL = P0.27) */
&i2c0 {
	status = "okay";
	clock-frequency = <I2C_BITRATE_FAST>;

	mpu6050: mpu6050@68 {
		compatible = "invensense,mpu6050";
		reg = <0x68>;
		status = "okay";
	};
};
